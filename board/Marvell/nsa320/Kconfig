## board/Marvell/nsa320/Kconfig
```kconfig
if TARGET_NSA320

config SYS_BOARD
       default "nsa320"

config SYS_VENDOR
       default "Marvell"

config SYS_CONFIG_NAME
       default "nsa320"

endif
```

## configs/nsa320_defconfig
```kconfig
CONFIG_ARM=y
CONFIG_KIRKWOOD=y
CONFIG_SYS_TEXT_BASE=0x600000
CONFIG_TARGET_NSA320=y
CONFIG_NR_DRAM_BANKS=2
CONFIG_IDENT_STRING="\nZyXEL NSA320 2-Bay Power Media Server"
CONFIG_BOOTDELAY=3
# CONFIG_DISPLAY_BOARDINFO is not set
CONFIG_HUSH_PARSER=y
CONFIG_SYS_PROMPT="NSA320> "
CONFIG_CMD_BOOTZ=y
# CONFIG_CMD_FLASH is not set
CONFIG_CMD_IDE=y
CONFIG_CMD_NAND=y
CONFIG_CMD_USB=y
# CONFIG_CMD_SETEXPR is not set
CONFIG_CMD_DHCP=y
CONFIG_CMD_MII=y
CONFIG_CMD_PING=y
CONFIG_CMD_EXT2=y
CONFIG_CMD_EXT4=y
CONFIG_CMD_FAT=y
CONFIG_MTDIDS_DEFAULT="nand0=orion_nand"
CONFIG_CMD_MTDPARTS=y
CONFIG_MTDPARTS_DEFAULT="mtdparts=orion_nand:1m(uboot),512k(uboot_env),512k(key_store),512k(info),10m(etc),10m(kernel_1),0x2fc0000(rootfs_1),10m(kernel_2),-(rootfs_2)"
CONFIG_CMD_UBI=y
CONFIG_ISO_PARTITION=y
CONFIG_EFI_PARTITION=y
CONFIG_ENV_IS_IN_NAND=y
CONFIG_MVSATA_IDE=y
# CONFIG_MMC is not set
CONFIG_MVGBE=y
CONFIG_MII=y
CONFIG_SYS_NS16550=y
CONFIG_USB=y
CONFIG_USB_EHCI_HCD=y
CONFIG_USB_STORAGE=y
CONFIG_LZMA=y
CONFIG_OF_LIBFDT=y

CONFIG_LOCALVERSION="-nsa320"
CONFIG_DISTRO_DEFAULTS=y
```
